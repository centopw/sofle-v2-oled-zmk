## config/west.yml
```yaml
manifest:
  remotes:
    - name: zmkfirmware
      url-base: https://github.com/zmkfirmware
  projects:
    - name: zmk
      remote: zmkfirmware
      revision: 8a44ef109ae301ce084b32dd5fe25200da9e402f
      import: app/west.yml
  self:
    path: config
```
